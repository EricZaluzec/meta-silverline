## meta-distro/conf/distro/silverline-distro-test.conf
```bitbake
require conf/distro/poky.conf



DISTRO = "silverline-distro-test"
DISTRO_NAME = "Silverline Distro Test"

# set the preferred version for kernel to the latest supported by fido
PREFERRED_VERSION_linux-yocto = "3.19%"
PREFERRED_VERSION_linux-yocto-quark = "3.8%"


# EFI_PROVIDER = "gummiboot"
# GUMMIBOOT_TIMEOUT = "3"


PACKAGE_CLASSES = "package_ipk"
```

## meta-galileo/conf/layer.conf
```bitbake
# We have a conf and classes directory, add to BBPATH
BBPATH := "${BBPATH}:${LAYERDIR}"

# We have a recipes directory, add to BBFILES
BBFILES := "${BBFILES} ${LAYERDIR}/recipes-*/*/*.bb \
        ${LAYERDIR}/recipes-*/*/*.bbappend"

BBFILE_COLLECTIONS += "meta-galileo"
BBFILE_PATTERN_meta-galileo := "^${LAYERDIR}/"
BBFILE_PRIORITY_meta-galileo = "6"
```
